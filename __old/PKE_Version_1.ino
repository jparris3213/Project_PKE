/**************************************************************************
  Using the examples for the OLED screen + the Stepper Motor, this will
  initally ONLY handle an example loop of the arms raising and lowering
  as well as a few animation / screen examples. The EMF Functionality is not
  currently included in this version (as of v1)

  TODO
    - Implement Button Controls of Stepper Motor
    - Create Scanning Animation/Page
    - EMF Functionality
    - HARDWARE = Open Step Motor area for air flow / add open vents
    - ground wire to board for Motor Controller


COMPLETE
    - Adjust start up order (Complete)
    - Create GB Logo 16x16 (Complete)
    -Integrated 9v battery (Completeish)
    - HARDWARE = solder currently 'taped' connections for more secure power flow (Complete)
    



  *************************************************************/

#include <SPI.h>
#include <Wire.h>
#include <Adafruit_GFX.h>
#include <Adafruit_SSD1306.h>
#include <Stepper.h>


#define SCREEN_WIDTH 128 // OLED display width, in pixels
#define SCREEN_HEIGHT 64 // OLED display height, in pixels

const int stepsPerRevolution = 2048;
// ULN2003 Motor Driver Pins
#define IN1 19
#define IN2 18
#define IN3 5
#define IN4 17

#define PIN_ANTENNA 27
#define CHECK_DELAY 1000
#define lmillis() ((long)millis())

// Initialize Stepper Motor
Stepper myStepper(stepsPerRevolution, IN1, IN3, IN2, IN4);

//Initialize Screens
#define OLED_RESET     -1 // Reset pin # (or -1 if sharing Arduino reset pin)
#define SCREEN_ADDRESS 0x3C ///< See datasheet for Address; 0x3D for 128x64, 0x3C for 128x32
Adafruit_SSD1306 display(SCREEN_WIDTH, SCREEN_HEIGHT, &Wire, OLED_RESET);

#define LOGO_HEIGHT   64
#define LOGO_WIDTH    58
static const unsigned char PROGMEM logo_bmp[] =
{
	0x00, 0x00, 0x00, 0x00, 0x00, 0x00, 0x00, 0x00, 0x00, 0x00, 0x00, 0x00, 0x00, 0x00, 0x00, 0x00, 
	0x00, 0x00, 0x00, 0x00, 0x00, 0x00, 0x00, 0x00, 0x00, 0x00, 0x00, 0x00, 0x00, 0x00, 0x00, 0x00, 
	0x00, 0x00, 0x00, 0x06, 0x00, 0x00, 0x00, 0x00, 0x00, 0x00, 0x00, 0x0e, 0x00, 0x00, 0x00, 0x00, 
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	0x00, 0x00, 0x00, 0x00, 0x00, 0x00, 0x00, 0x00, 0x00, 0x00, 0x00, 0x00, 0x00, 0x00, 0x00, 0x00
};



void setup() {

  pinMode(PIN_ANTENNA, INPUT);
    //Step 1: Screen voltage loop
    // SSD1306_SWITCHCAPVCC = generate display voltage from 3.3v interally (IE over Serial)
  if(!display.begin(SSD1306_SWITCHCAPVCC, SCREEN_ADDRESS)) {
    Serial.println(F("SSD1306 allocation failed"));
    for(;;); // Don't proceed, loop forever
  };

//Step 2: Display Adafruit and Ghostbusters Logo
  display.display();//Should display Adafruit Industries Logo
  delay(2000); // Pause for 2 seconds

  // Clear the buffer
  display.clearDisplay();
  
  //Draw GB Logo Bitmap
  testdrawbitmap();
  delay(2000);



//Step 3: Test PKE Wings (Up a little under half of a full rotation, and then back the same amount)
  myStepper.setSpeed(8);//Speed of Stepper Motor, Currently a little slow at 5
  Serial.begin(115200); // Initialize Serial (USB to IDE Monitor) at Baud Speed 115200
  myStepper.step(1023); // Extend Arms about 75%
  delay(500);
  myStepper.step(-1023); //Retract Arms to Starting Position
  delay(2000);
  

//Step 4: Text Example (need a fake "status" printout)
    
//Step 5: Animation Example of Lines

//Step 6: "Status Update" Text


//Step 7 MAIN LOOP: Pre version 2, example animation of main screen with selection info at bottom. Version 2 will have EMF readings instead of example data/loop


  display.clearDisplay();

}

void showReadings(int emfValue) {
    display.clearDisplay();   
    display.setTextSize(3);
    display.setTextColor(WHITE);
    display.setCursor(5,40);
    display.println("PKE");

    display.setCursor(70,40);
    display.println(emfValue);

    display.display();
}

void loop() {
  //testdrawline();      // Draw many lines
  
  //The Below SHOULD display the "PKE" (Read: EMF) reading on the screen
  
  static int avgValue = 0, emfValue = 0;
    static long nextCheck = 0, emfSum = 0, iterations = 0;

    emfValue = constrain(analogRead(PIN_ANTENNA), 0, 1023);
    emfSum += emfValue;
    iterations++;
    if (lmillis() - nextCheck >= 0) {
        avgValue = emfSum / iterations;
        emfSum = 0;
        iterations = 0;
        showReadings(avgValue);
        nextCheck = lmillis() + CHECK_DELAY;
    }


    display.drawRoundRect(0, 5, 126, 30, 2, WHITE);
    display.fillRect(5, 10, 120, 23, BLACK);
    display.fillRect(5, 10, map(emfValue, 0, 1023, 0, 118), 20, WHITE);
    display.display();

}


// Classes and Internal...stuff...idk.

void testdrawline() {
  int16_t i;

  display.clearDisplay(); // Clear display buffer

  for(i=0; i<display.width(); i+=4) {
    display.drawLine(0, 0, i, display.height()-1, SSD1306_WHITE);
    display.display(); // Update screen with each newly-drawn line
    delay(1);
  }
  for(i=0; i<display.height(); i+=4) {
    display.drawLine(0, 0, display.width()-1, i, SSD1306_WHITE);
    display.display();
    delay(1);
  }
  delay(250);

  display.clearDisplay();

  delay(2000); // Pause for 2 seconds
}


void testdrawbitmap(void) {
  display.clearDisplay();

  display.drawBitmap(
    (display.width()  - LOGO_WIDTH ) / 2,
    (display.height() - LOGO_HEIGHT) / 2,
    logo_bmp, LOGO_WIDTH, LOGO_HEIGHT, 1);
  display.setCursor(2,2);
  display.setTextSize(2);
  display.println("Ghostbusters");
  display.setTextSize(1);
  display.setCursor(60,0);
  display.println("PKE Meter v1.0");
  display.display();
  delay(1000);
}